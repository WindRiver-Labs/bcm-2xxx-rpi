## conf/layer.conf
```bitbake
#
# Copyright (C) 2018-2019 Wind River Systems, Inc.
#

# We have a conf and classes directory, add to BBPATH
BBPATH =. "${LAYERDIR}:"

# We have a packages directory, add to BBFILES
BBFILES += "${LAYERDIR}/recipes-*/*/*.bb \
	${LAYERDIR}/recipes-*/*/*.bbappend"

BBFILE_COLLECTIONS += "wr-bcm-2xxx-rpi"
BBFILE_PATTERN_wr-bcm-2xxx-rpi := "^${LAYERDIR}/"
BBFILE_PRIORITY_wr-bcm-2xxx-rpi = "7"

LAYER_PATH_wr-bcm-2xxx-rpi = "${LAYERDIR}"

# This should only be incremented on significant changes that will
# cause compatibility issues with other layers
LAYERVERSION_wr-bcm-2xxx-rpi = "1"

LAYERDEPENDS_wr-bcm-2xxx-rpi = "core wrlinux raspberrypi"

LAYERSERIES_COMPAT_wr-bcm-2xxx-rpi = "wrl hardknott"

NON_MULTILIB_RECIPES_append = " u-boot rpi-bootfiles rpi-config rpi-cmdline"

LICENSE_PATH += "${LAYERDIR}/files/custom-licenses"

LAYERRECOMMENDS_wr-bcm-2xxx-rpi  = "bcm-2xxx-rpi-dl"

BBFILES_DYNAMIC += " \
    xfce-layer:${LAYERDIR}/dynamic-layers/meta-xfce/recipes-*/*/*.bbappend \
"
```

## conf/machine/bcm-2xxx-rpi.conf
```bitbake
#@TYPE: Machine
#@NAME: bcm-2xxx-rpi.inc
#@DESCRIPTION: Machine configuration for running a bcm-2xxx-rpi

require bcm-2xxx-rpi.inc
EXTRA_IMAGECMD_jffs2 = "--pad --no-cleanmarkers --eraseblock=128"

MACHINE_FEATURES = "ext3 usbhost vfat alsa"
 
DISTRO_FEATURES_append = " wifi bluetooth"
PREFERRED_PROVIDER_virtual/kernel ?= "linux-yocto"
```

## conf/machine/bcm-2xxx-rpi.inc
```bitbake
#@TYPE: Machine inc.
#@NAME: bcm-2xxx-rpi layer

DEFAULTTUNE = "cortexa72"
require conf/machine/include/tune-cortexa72.inc

require conf/machine/include/soc-family.inc
SOC_FAMILY =. "rpi:"

MACHINE_FEATURES += "usbhost ext3 screen alsa vfat"

KERNEL_IMAGETYPE = ""
KERNEL_IMAGETYPES = "Image.gz Image"

SERIAL_CONSOLE = "115200 ttyS0"

# wic
WIC_CREATE_EXTRA_ARGS = "--no-fstab-update"
IMAGE_FSTYPES += "tar.bz2 wic wic.bmap ext4"
WKS_FILE ?= "bcm-2xxx-rpi-sdimage.wks"
do_image_wic[depends] += "mtools-native:do_populate_sysroot dosfstools-native:do_populate_sysroot"
do_image_wic[depends] += "u-boot:do_deploy"

# multilib support
MULTILIBS ?= "multilib:lib32"
DEFAULTTUNE_virtclass-multilib-lib32 ?= "armv7athf-neon"

PREFERRED_PROVIDER_virtual/kernel ??= "linux-yocto"
PREFERRED_VERSION_linux-yocto ?= "5.4%"

RPI_KERNEL_DEVICETREE_OVERLAYS ?= " \
    overlays/at86rf233.dtbo \
    overlays/disable-bt.dtbo \
    overlays/dwc2.dtbo \
    overlays/gpio-key.dtbo \
    overlays/hifiberry-amp.dtbo \
    overlays/hifiberry-dac.dtbo \
    overlays/hifiberry-dacplus.dtbo \
    overlays/hifiberry-digi.dtbo \
    overlays/i2c-rtc.dtbo \
    overlays/iqaudio-dac.dtbo \
    overlays/iqaudio-dacplus.dtbo \
    overlays/miniuart-bt.dtbo \
    overlays/mcp2515-can0.dtbo \
    overlays/pitft22.dtbo \
    overlays/pitft28-resistive.dtbo \
    overlays/pitft28-capacitive.dtbo \
    overlays/pitft35-resistive.dtbo \
    overlays/pps-gpio.dtbo \
    overlays/rpi-ft5406.dtbo \
    overlays/rpi-poe.dtbo \
    overlays/vc4-kms-v3d.dtbo \
    overlays/vc4-fkms-v3d.dtbo \
    overlays/w1-gpio-pullup.dtbo \
    overlays/w1-gpio.dtbo \
    overlays/gpio-ir.dtbo \
    overlays/gpio-ir-tx.dtbo \
"

def make_dtb_boot_files(d):
    # Generate IMAGE_BOOT_FILES entries for device tree files listed in
    # KERNEL_DEVICETREE.
    alldtbs = d.getVar('KERNEL_DEVICETREE')
    imgtyp = d.getVar('KERNEL_IMAGETYPE')

    def transform(dtb):
        base = os.path.basename(dtb)
        if dtb.endswith('dtb'):
            # eg: whatever/bcm2708-rpi-b.dtb has:
            #     DEPLOYDIR file: bcm2708-rpi-b.dtb
            #     destination: bcm2708-rpi-b.dtb
            return base
        elif dtb.endswith('dtbo'):
            # overlay dtb:
            # eg: overlays/hifiberry-amp.dtbo has:
            #     DEPLOYDIR file: hifiberry-amp.dtbo
            #     destination: overlays/hifiberry-amp.dtbo
            return '{};{}'.format(base, dtb)

    return ' '.join([transform(dtb) for dtb in alldtbs.split(' ') if dtb])



# For runqemu, these settings are from qemuarm64
IMAGE_CLASSES += "qemuboot"

EXTRA_IMAGEDEPENDS += "qemu-native qemu-helper-native"

QB_SYSTEM_NAME = "qemu-system-aarch64"
QB_MACHINE = "-machine virt"
QB_CPU = "-cpu cortex-a57"
QB_CPU_KVM = "-cpu host -machine gic-version=3"
QB_DRIVE_TYPE = "/dev/vdb"
# Standard Serial console
QB_KERNEL_CMDLINE_APPEND = "console=ttyAMA0"
QB_DEFAULT_KERNEL = "Image"
# For graphics to work we need to define the VGA device as well as the necessary USB devices
QB_OPT_APPEND = "-show-cursor -device virtio-gpu-pci"
QB_OPT_APPEND += "-device qemu-xhci -device usb-tablet -device usb-kbd"
# Add the 'virtio-rng-pci' device otherwise the guest may run out of entropy
QB_OPT_APPEND += "-object rng-random,filename=/dev/urandom,id=rng0 -device virtio-rng-pci,rng=rng0"
# Virtio Networking support
QB_TAP_OPT = "-netdev tap,id=net0,ifname=@TAP@,script=no,downscript=no"
QB_NETWORK_DEVICE = "-device virtio-net-device,netdev=net0,mac=@MAC@"
# Virtio block device
QB_ROOTFS_OPT = "-drive id=disk0,file=@ROOTFS@,if=none,format=raw -device virtio-blk-device,drive=disk0"
# Virtio serial console
QB_SERIAL_OPT = "-device virtio-serial-device -chardev null,id=virtcon -device virtconsole,chardev=virtcon"
QB_TCPSERIAL_OPT = "-device virtio-serial-device -chardev socket,id=virtcon,port=@PORT@,host=127.0.0.1 -device virtconsole,chardev=virtcon"
```

## conf/machine/bcm-2xxx-rpi4.conf
```bitbake
#@TYPE: Machine
#@NAME: bcm-2xxx-rpi.inc
#@DESCRIPTION: Machine configuration for running a bcm-2xxx-rpi

require bcm-2xxx-rpi.inc
require rpi-graphics.inc
EXTRA_IMAGECMD_jffs2 = "--pad --no-cleanmarkers --eraseblock=128"
 
DISTRO_FEATURES_append = " wifi bluetooth"

MACHINEOVERRIDES .= ":raspberrypi4"

KERNEL_BOOTCMD ?= "booti"

UBOOT_MACHINE = "rpi_arm64_config"

EX_KERNEL_DEVICETREE ?= "broadcom/bcm2710-rpi-3-b.dtb broadcom/bcm2710-rpi-3-b-plus.dtb"

KERNEL_DEVICETREE = "broadcom/bcm2711-rpi-4-b.dtb ${EX_KERNEL_DEVICETREE} ${RPI_KERNEL_DEVICETREE_OVERLAYS}"

SDIMG_KERNELIMAGE ?= "kernel8.img"
IMAGE_BOOT_FILES ?= "bcm2835-bootfiles/*\
                     Image ${@make_dtb_boot_files(d)} \
		     u-boot.bin;${SDIMG_KERNELIMAGE} boot.scr cmdline.txt config.txt\
"
INITRAMFS_IMAGE ??= ""
IMAGE_BOOT_FILES_append = " ${@bb.utils.contains('DISTRO_FEATURES', 'ostree', '${INITRAMFS_IMAGE}-${MACHINE}.${INITRAMFS_FSTYPES};initramfs', '', d)}"

NON_MULTILIB_RECIPES_append = " boot-config"
NON_MULTILIB_RECIPES_append = " rpi-u-boot-scr"

OSTREE_BOOTSCR_PRECMD ?= "setenv skip_script_fdt yes;"
SKIP_SCRIPT_FDT ?= "yes"

OSTREE_KERNEL ?= "Image"
OSTREE_FDISK_FSZ ?= "128"
OSTREE_SD_UBOOT_WIC1 ?= ""
OSTREE_SD_UBOOT_WIC2 ?= ""
OSTREE_SD_UBOOT_WIC3 ?= ""
OSTREE_SD_UBOOT_WIC4 ?= ""
OSTREE_UBOOT_CMD ?= "booti"
# Don't set a default dtb for the board, the u-boot loads it into the fdt_addr
# automatically, a lot of devices would not work if we load it again to
# override fdt_addr.
DEFAULT_DTB ?= ""
OSTREE_COPY_IMAGE_BOOT_FILES = "1"
OSTREE_NETINST_DEV ?= "/dev/mmcblk0,/dev/sda,/dev/vda"
OSTREE_NETINST_ARGS ?= "${OSTREE_CONSOLE} bl=ufsd rdinit=/install instdev=${OSTREE_NETINST_DEV} instname=wrlinux instbr=\$BRANCH insturl=\$URL instab=${OSTREE_USE_AB} instsf=1 instdate=BUILD_DATE"
```

## rpi-graphics/conf/layer.conf
```bitbake
#
# Copyright (C) 2019-2020 Wind River Systems, Inc.
#

# We have a conf and classes directory, add to BBPATH
BBPATH .= ":${LAYERDIR}"

require rpi-graphics.inc

# We have a packages directory, add to BBFILES
BBFILES += "${LAYERDIR}/recipes-*/*/*.bb \
	${LAYERDIR}/recipes-*/*/*.bbappend \
	${LAYERDIR}/classes/*.bbclass"

BBFILE_COLLECTIONS += "rpi-graphics-layer"
BBFILE_PATTERN_rpi-graphics-layer := "^${LAYERDIR}/"
BBFILE_PRIORITY_rpi-graphics-layer = "7"

MACHINE_SOCARCH_bcm-2xxx-rpi4 = "bcm-2xxx-rpi4"

BANNER[bcm-2xxx-rpi] = "The raspberrypi graphics layer includes third party components, where additional third party licenses may apply."

LAYERSERIES_COMPAT_rpi-graphics-layer = "zeus"
```

## scripts/lib/wic/canned-wks/sdimage.wks
```
# short-description: Create a bcm-2xxx-rpi disk image (SD card)
# long-description: Create a partitioned disk image for bcm-2xxx-rpi
# The partition is to accommodate kernel, dtb and rootfs.

part /boot --ondisk mmcblk --fstype=vfat --label boot --active --align 4096 --size 100
part / --source rootfs --ondisk mmcblk --fstype=ext4 --label root --align 4096
```

## wic/bcm-2xxx-rpi-sdimage.wks
```
# short-description: Create a bcm-2xxx-rpi disk image (SD card)
# long-description: Create a partitioned disk image for bcm-2xxx-rpi
# The partition is to accommodate kernel, dtb and rootfs.

part /boot --source bootimg-partition --ondisk mmcblk0 --fstype=vfat --label boot --active --align 4096 --fixed-size 256M
part / --source rootfs --ondisk mmcblk0 --fstype=ext4 --label root --align 4096
```
